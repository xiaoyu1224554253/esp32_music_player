## sdkconfig.defaults
```kconfig
# ESP-IDF 默认配置 (ES3C28P: ESP32-S3 N16R8)
CONFIG_IDF_TARGET="esp32s3"
CONFIG_ESP32S3_DEFAULT_CPU_FREQ_240=y
CONFIG_FREERTOS_HZ=1000

# Flash 16MB
CONFIG_ESPTOOLPY_FLASHSIZE_16MB=y

# PSRAM 8MB (Octal)
CONFIG_SPIRAM=y
CONFIG_SPIRAM_MODE_OCT=y
CONFIG_SPIRAM_SIZE=8388608
CONFIG_SPIRAM_FETCH_INSTRUCTIONS=y
CONFIG_SPIRAM_RODATA_PSRAM_DATA=y

# 自定义分区表
CONFIG_PARTITION_TABLE_CUSTOM=y
CONFIG_PARTITION_TABLE_CUSTOM_FILENAME="main/partitions.csv"

# 主串口波特率
CONFIG_ESP_CONSOLE_UART_BAUDRATE_115200=y

# C++ / RTTI (LVGL 需 C++)
CONFIG_COMPILER_CXX_EXCEPTIONS=y
CONFIG_COMPILER_CXX_RTTI=y

# LVGL 基础配置 (lvgl/lvgl 组件 Kconfig 前缀为 LVGL_)
CONFIG_LVGL_ENABLE_USER_DATA=y
CONFIG_LVGL_FONT_FMT_TXT_LARGE=y
CONFIG_LVGL_MEM_CUSTOM=y
CONFIG_LVGL_MEM_SIZE=3145728
CONFIG_LVGL_TICK_CUSTOM=y
CONFIG_LVGL_TASK_HANDLER_IN_PERIODIC=y
```
